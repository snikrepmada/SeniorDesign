/*******************************************************************************
 * File Name   : ov2640.c
 * Author      : Adam Perkins
 * Version     : 0.1.0
 * Date        : 30-January-2016
 * Description : OV2640 camera module
 *******************************************************************************
 *
 * Used to initialize and access the OV2640 camera module
 *
 ******************************************************************************/

/* Includes ----------------------------------------------------------------- */
#include "ov2640.h"
#include "i2c.h"

/* Private typedef ---------------------------------------------------------- */
/* Private define ----------------------------------------------------------- */
#define DELAY 2
#define TIMEOUT 10000

/* Bits definitions --------------------------------------------------------- */
/* Private macro ------------------------------------------------------------ */
/* Private variables -------------------------------------------------------- */

static const uint8_t default_regs[][2] =
{
  {0xff, 0x0},
  {0x2c, 0xff},
  {0x2e, 0xdf},
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  {0xff,0xff}
};

static const uint8_t rgb565_regs[][2] =
{
  { BANK_SEL, BANK_SEL_DSP },
  { RESET, RESET_DVP },
  { IMAGE_MODE, IMAGE_MODE_RGB565 },
  { 0xD7, 0x03 },
  { 0xE1, 0x77 },
  { RESET, 0x00 },
  { 0, 0 }
};

/* Private function prototypes ---------------------------------------------- */
uint8_t SCCB_Write(uint8_t addr, uint8_t data);
uint8_t SCCB_Read(uint8_t addr);
void OV2640_ReadID(OV2640_IDTypeDef* OV2640ID);
int32_t OV2640_CheckID(OV2640_IDTypeDef* OV2640ID);
void OV2640_SetCameraRegisters(void);

/* Private functions -------------------------------------------------------- */
uint8_t SCCB_Write(uint8_t addr, uint8_t data)
{
  uint8_t ret = 0;
  uint8_t buf[] = {addr, data};

  __disable_irq();
  if(HAL_I2C_Master_Transmit(&hi2c1, OV2640_WRITE_ADDR, buf, 2, TIMEOUT) != HAL_OK)
  {
    ret = 0xFF;
  }
  __enable_irq();
  return ret;
}

uint8_t SCCB_Read(uint8_t addr)
{
  uint8_t data = 0;
  __disable_irq();
  if(HAL_I2C_Master_Transmit(&hi2c1, OV2640_READ_ADDR, &addr, 1, TIMEOUT) != HAL_OK)
  {
    data = 0xFF;
    goto error_w;
  }
  if(HAL_I2C_Master_Receive(&hi2c1, OV2640_READ_ADDR, &data, 1, TIMEOUT) != HAL_OK)
  {
    data = 0xFF;
  }
  error_w:
    __enable_irq();
    return data;
}

void OV2640_ReadID(OV2640_IDTypeDef* OV2640ID)
{
  SCCB_Write(0xFF, 0x01);
  OV2640ID->Manufacturer_ID1 = SCCB_Read(MIDH);
  OV2640ID->Manufacturer_ID2 = SCCB_Read(MIDL);
  OV2640ID->Version = SCCB_Read(REG_VER);
  OV2640ID->PID = SCCB_Read(REG_PID);
}

int32_t OV2640_CheckID(OV2640_IDTypeDef* OV2640ID)
{
  if(((OV2640ID->Manufacturer_ID1 << 8) | (OV2640ID->Manufacturer_ID2)) != OV2640_MANUFACTURER_ID)
  {
    return -1;
  }
  if(OV2640ID->PID != OV2640_PID)
  {
    return -1;
  }
  if(OV2640ID->Version != OV2640_VERSION)
  {
    return -1;
  }
  return 0;
}

void OV2640_SetCameraRegisters(void)
{
  uint32_t i = 0;
  const uint8_t(*regs)[2];
  uint8_t reg;

  /* Reset all the registers */
  SCCB_Write(BANK_SEL, BANK_SEL_SENSOR);
  SCCB_Write(COM7, COM7_SRST);

  HAL_Delay(10);

  /* Write initial registers */
  i = 0;
  regs = default_regs;
  while(regs[i][0])
  {
    SCCB_Write(regs[i][0], regs[i][1]);
    HAL_Delay(DELAY);
    i++;
  }

  /* Set output image format */
  i = 0;
  regs = rgb565_regs;
  while(regs[i][0])
  {
    SCCB_Write(regs[i][0], regs[i][1]);
    HAL_Delay(DELAY);
    i++;
  }
  SCCB_Write(0xFF, 0x01);
  reg = SCCB_Read(COM7);
  reg |= COM7_COLOR_BAR;
  SCCB_Write(COM7, reg);
}

/* Public functions --------------------------------------------------------- */
extern int32_t OV2640_Init(void)
{
  OV2640_IDTypeDef OV2640ID;

  DCMI_PWRDN_HIGH();
  HAL_Delay(10);

  DCMI_PWRDN_LOW();
  HAL_Delay(100);

  DCMI_RST_LOW();
  HAL_Delay(10);

  DCMI_RST_HIGH();
  HAL_Delay(10);

  OV2640_ReadID(&OV2640ID);
  
  if(OV2640_CheckID(&OV2640ID) != 0)
  {
    printf("Camera OV2640 not found.\n\r");
    return -1;
  }
  
  OV2640_SetCameraRegisters();

  return 0;
}

/* ****************************** END OF FILE ******************************* */
